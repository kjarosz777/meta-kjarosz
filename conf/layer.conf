## conf/layer.conf
```bitbake
# We have a conf and classes directory, add to BBPATH
BBPATH .= ":${LAYERDIR}"

# We have recipes-* directories, add to BBFILES
BBFILES += "${LAYERDIR}/recipes-*/*/*.bb \
            ${LAYERDIR}/recipes-*/*/*.bbappend"

BBFILE_COLLECTIONS += "meta-kjarosz"
BBFILE_PATTERN_meta-kjarosz = "^${LAYERDIR}/"
BBFILE_PRIORITY_meta-kjarosz = "6"

LAYERDEPENDS_meta-kjarosz = "core"
LAYERSERIES_COMPAT_meta-kjarosz = "kirkstone"
```
